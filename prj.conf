## prj.conf
```kconfig
# Core Configuration
CONFIG_MAIN_STACK_SIZE=2048
CONFIG_IDLE_STACK_SIZE=1024
CONFIG_LOG=y
CONFIG_LOG_DEFAULT_LEVEL=1

# UART
CONFIG_SERIAL=y

# LED Strip
CONFIG_LED_STRIP=y
CONFIG_WS2812_STRIP=y
```

## boards/esp32c3_supermini.overlay
```dts
/ {
    leds {
        compatible = "worldsemi,ws2812";
        label = "WS2812";
        chain-length = <10>; // Number of LEDs
        spi-bus = <&spi2>; // Use SPI2
        data-gpios = <&gpio0 3 GPIO_ACTIVE_HIGH>; // DATA_PIN = GPIO3
    };
};

&spi2 {
    status = "okay";
};

&uart0 {
    status = "okay";
    current-speed = <115200>;
    pinctrl-0 = <&uart0_default>;
    pinctrl-names = "default";
};
```

## src/main.c
```c
#include <zephyr.h>
#include <drivers/led_strip.h>
#include <logging/log.h>

LOG_MODULE_REGISTER(main);

void main(void) {
    const struct device *led_strip = DEVICE_DT_GET(DT_ALIAS(led_strip));

    if (!device_is_ready(led_strip)) {
        LOG_ERR("LED strip device not ready");
        return;
    }

    LOG_INF("LED strip initialized");

    struct led_rgb pixels[10] = {0};

    while (1) {
        // Set all LEDs to red
        for (int i = 0; i < 10; i++) {
            pixels[i].r = 255;
            pixels[i].g = 0;
            pixels[i].b = 0;
        }
        led_strip_update_rgb(led_strip, pixels, 10);

        k_sleep(K_MSEC(1000));

        // Turn off all LEDs
        for (int i = 0; i < 10; i++) {
            pixels[i].r = 0;
            pixels[i].g = 0;
            pixels[i].b = 0;
        }
        led_strip_update_rgb(led_strip, pixels, 10);

        k_sleep(K_MSEC(1000));
    }
}
```
